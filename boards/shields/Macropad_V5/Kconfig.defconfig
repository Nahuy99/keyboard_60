## boards/shields/Macropad_V5/Kconfig.defconfig
```kconfig
if SHIELD_MACROPAD_V5_LEFT
    config ZMK_KEYBOARD_NAME
        default "Macropad_V5"

    config ZMK_SPLIT_ROLE_CENTRAL
        default y

endif

if SHIELD_MACROPAD_V5_LEFT || SHIELD_MACROPAD_V5_RIGHT

config ZMK_SPLIT
    default y

endif
```

## boards/shields/Macropad_V5/Kconfig.shield
```kconfig
config SHIELD_MACROPAD_V5_LEFT
    def_bool $(shields_list_contains, Macropad_V5_left)

config SHIELD_MACROPAD_V5_RIGHT
    def_bool $(shields_list_contains, Macropad_V5_right)
```
